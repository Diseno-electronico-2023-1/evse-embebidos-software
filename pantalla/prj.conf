## CMakeLists.txt
```
# SPDX-License-Identifier: Apache-2.0

cmake_minimum_required(VERSION 3.20.0)

find_package(Zephyr REQUIRED HINTS $ENV{ZEPHYR_BASE})
project(lvgl)

FILE(GLOB app_sources src/*.c)

target_sources(app PRIVATE ${app_sources})
```

## prj.conf
```kconfig
CONFIG_LV_Z_MEM_POOL_NUMBER_BLOCKS=8
CONFIG_MAIN_STACK_SIZE=2048

CONFIG_DISPLAY=y
CONFIG_DISPLAY_LOG_LEVEL_ERR=y

CONFIG_PRINTK=y
CONFIG_LOG=y

CONFIG_LVGL=y
CONFIG_LV_MEM_CUSTOM=y
CONFIG_LV_USE_LOG=y
CONFIG_LV_USE_LABEL=y
CONFIG_LV_USE_BTN=y
CONFIG_LV_USE_IMG=y
CONFIG_LV_FONT_MONTSERRAT_14=y
```

## src/main.c
```c
#include <stdio.h>
#include <string.h>

#include <lvgl.h>
#include <zephyr/device.h>
#include <zephyr/devicetree.h>
#include <zephyr/drivers/display.h>
#include <zephyr/drivers/gpio.h>
#include <zephyr/kernel.h>
#include <zephyr/sys/printk.h>

#define LOG_LEVEL CONFIG_LOG_DEFAULT_LEVEL
#include <zephyr/logging/log.h>
LOG_MODULE_REGISTER(app);

#include "csr.h"
#include "screens/offScreen.c"
#include "screens/welcomeScreen.c"
#include "screens/profileScreen.c"
#include "screens/statusScreen.c"

// Botones
    const int btn_back = 1;
    const int btn_up   = 2;
    const int btn_down = 4;
    const int btn_next = 8;

int moveSelector(int selector, int btn_state, int maxSelector){
    if (btn_state == btn_down){
        if (selector == maxSelector){
            selector = 1;
        } else{
            selector ++;
        }
    } else if (btn_state == btn_up){
        if (selector == 1){
            selector = maxSelector;
        } else{
            selector --;
        }
    }
    return selector;
}


void main(void){
    char names[3][16];
    strncpy(names[0], "Hugo", sizeof(names[0]) - 1);
    strncpy(names[1], "Paco", sizeof(names[1]) - 1);
    strncpy(names[2], "Luis", sizeof(names[2]) - 1);

    int percent = 0;


    printk("Inicio \n");

    bool work = 1;
    int state;
    int btn_state;
    int selector = 1;
    int profile_sel = 1;

    // Estados
    const int welcome = '1';
    const int selprofile = '2';
    const int status = '3';
    const int end = '4';
        
    state = welcome;
    welcome_screen();
    lv_task_handler();

    while (work){
        switch (state){
        case welcome :
            btn_state = user_gpio_in_read();

            if (btn_state != 0){   
                profile_screen(1, names);
                lv_task_handler();
                selector = 1;
                state = selprofile;
            }
            break;
        
        case selprofile :
            btn_state = user_gpio_in_read();
            
            if (btn_state != 0){   
                if (btn_state == btn_back){
                    state = welcome;
                    welcome_screen();
                    lv_task_handler();
                } else if (btn_state == btn_next){
                    state = status;
                    profile_sel = selector - 1;
                    selector = 1;
                    status_screen(selector, names[profile_sel], percent);
                    lv_task_handler();
                } else{
                    selector = moveSelector(selector, btn_state, 3);
                    profile_screen(selector, names);
                    lv_task_handler();
                }
            }
            break;

        case status :
            btn_state = user_gpio_in_read();
            
            if (btn_state != 0){   
                if (btn_state == btn_back){
                    state = selprofile;
                    selector = 1;
                    profile_screen(selector, names);
                    lv_task_handler();                    
                } else if (btn_state == btn_next){
                    off_screen();
                    lv_task_handler();
                    selector = 1;
                    state = end;
                } else{
                    selector = moveSelector(selector, btn_state, 5);
                    status_screen(selector, names[profile_sel]);
                    lv_task_handler();
                }
            }
            break;

        default:
            work = 0;
            break;
        }

        k_sleep(K_MSEC(100));
    }
    
    printk("Fin \n");

}


/* void main(void){
    bool work = 1;
    int sel = 1;

    char names[3][16];
    strncpy(names[0], "Hugo", sizeof(names[0]) - 1);
    strncpy(names[1], "Paco", sizeof(names[1]) - 1);
    strncpy(names[2], "Luis", sizeof(names[2]) - 1);

    int percent = 0;

    while (work){
        profile_screen(sel, names);
        lv_task_handler();
        k_sleep(K_MSEC(500));
        sel++;
        if (sel == 4){
            sel = 1;
        }
    }
} */

//k_sleep(K_MSEC(1000));
//perfil();
//lv_task_handler();
//printk("Data: %x \n", data);
//user_gpio_out_write(1);
```

## src/csr.h
```c
//--------------------------------------------------------------------------------
// Auto-generated by LiteX (782f045b) on 2023-06-22 08:23:23
//--------------------------------------------------------------------------------
#define CSR_BASE 0xf0000000L

#define MMPTR(a) (*((volatile uint32_t *)(a)))

static inline void csr_write_simple(unsigned long v, unsigned long a)
{
	MMPTR(a) = v;
}

static inline unsigned long csr_read_simple(unsigned long a)
{
	return MMPTR(a);
}

/* user_gpio */
#define CSR_USER_GPIO_BASE (CSR_BASE + 0x5800L)
#define CSR_USER_GPIO_OE_ADDR (CSR_BASE + 0x5800L)
#define CSR_USER_GPIO_OE_SIZE 1
static inline uint32_t user_gpio_oe_read(void) {
	return csr_read_simple((CSR_BASE + 0x5800L));
}
static inline void user_gpio_oe_write(uint32_t v) {
	csr_write_simple(v, (CSR_BASE + 0x5800L));
}
#define CSR_USER_GPIO_IN_ADDR (CSR_BASE + 0x5804L)
#define CSR_USER_GPIO_IN_SIZE 1
static inline uint32_t user_gpio_in_read(void) {
	return csr_read_simple((CSR_BASE + 0x5804L));
}
#define CSR_USER_GPIO_OUT_ADDR (CSR_BASE + 0x5808L)
#define CSR_USER_GPIO_OUT_SIZE 1
static inline uint32_t user_gpio_out_read(void) {
	return csr_read_simple((CSR_BASE + 0x5808L));
}
static inline void user_gpio_out_write(uint32_t v) {
	csr_write_simple(v, (CSR_BASE + 0x5808L));
}
#define CSR_USER_GPIO_MODE_ADDR (CSR_BASE + 0x580cL)
#define CSR_USER_GPIO_MODE_SIZE 1
static inline uint32_t user_gpio_mode_read(void) {
	return csr_read_simple((CSR_BASE + 0x580cL));
}
static inline void user_gpio_mode_write(uint32_t v) {
	csr_write_simple(v, (CSR_BASE + 0x580cL));
}
#define CSR_USER_GPIO_EDGE_ADDR (CSR_BASE + 0x5810L)
#define CSR_USER_GPIO_EDGE_SIZE 1
static inline uint32_t user_gpio_edge_read(void) {
	return csr_read_simple((CSR_BASE + 0x5810L));
}
static inline void user_gpio_edge_write(uint32_t v) {
	csr_write_simple(v, (CSR_BASE + 0x5810L));
}
#define CSR_USER_GPIO_EV_STATUS_ADDR (CSR_BASE + 0x5814L)
#define CSR_USER_GPIO_EV_STATUS_SIZE 1
static inline uint32_t user_gpio_ev_status_read(void) {
	return csr_read_simple((CSR_BASE + 0x5814L));
}
#define CSR_USER_GPIO_EV_STATUS_I0_OFFSET 0
#define CSR_USER_GPIO_EV_STATUS_I0_SIZE 1
static inline uint32_t user_gpio_ev_status_i0_extract(uint32_t oldword) {
	uint32_t mask = 0x1;
	return ( (oldword >> 0) & mask );
}
static inline uint32_t user_gpio_ev_status_i0_read(void) {
	uint32_t word = user_gpio_ev_status_read();
	return user_gpio_ev_status_i0_extract(word);
}
#define CSR_USER_GPIO_EV_STATUS_I1_OFFSET 1
#define CSR_USER_GPIO_EV_STATUS_I1_SIZE 1
static inline uint32_t user_gpio_ev_status_i1_extract(uint32_t oldword) {
	uint32_t mask = 0x1;
	return ( (oldword >> 1) & mask );
}
static inline uint32_t user_gpio_ev_status_i1_read(void) {
	uint32_t word = user_gpio_ev_status_read();
	return user_gpio_ev_status_i1_extract(word);
}
#define CSR_USER_GPIO_EV_STATUS_I2_OFFSET 2
#define CSR_USER_GPIO_EV_STATUS_I2_SIZE 1
static inline uint32_t user_gpio_ev_status_i2_extract(uint32_t oldword) {
	uint32_t mask = 0x1;
	return ( (oldword >> 2) & mask );
}
static inline uint32_t user_gpio_ev_status_i2_read(void) {
	uint32_t word = user_gpio_ev_status_read();
	return user_gpio_ev_status_i2_extract(word);
}
#define CSR_USER_GPIO_EV_STATUS_I3_OFFSET 3
#define CSR_USER_GPIO_EV_STATUS_I3_SIZE 1
static inline uint32_t user_gpio_ev_status_i3_extract(uint32_t oldword) {
	uint32_t mask = 0x1;
	return ( (oldword >> 3) & mask );
}
static inline uint32_t user_gpio_ev_status_i3_read(void) {
	uint32_t word = user_gpio_ev_status_read();
	return user_gpio_ev_status_i3_extract(word);
}
#define CSR_USER_GPIO_EV_PENDING_ADDR (CSR_BASE + 0x5818L)
#define CSR_USER_GPIO_EV_PENDING_SIZE 1
static inline uint32_t user_gpio_ev_pending_read(void) {
	return csr_read_simple((CSR_BASE + 0x5818L));
}
static inline void user_gpio_ev_pending_write(uint32_t v) {
	csr_write_simple(v, (CSR_BASE + 0x5818L));
}
#define CSR_USER_GPIO_EV_PENDING_I0_OFFSET 0
#define CSR_USER_GPIO_EV_PENDING_I0_SIZE 1
static inline uint32_t user_gpio_ev_pending_i0_extract(uint32_t oldword) {
	uint32_t mask = 0x1;
	return ( (oldword >> 0) & mask );
}
static inline uint32_t user_gpio_ev_pending_i0_read(void) {
	uint32_t word = user_gpio_ev_pending_read();
	return user_gpio_ev_pending_i0_extract(word);
}
static inline uint32_t user_gpio_ev_pending_i0_replace(uint32_t oldword, uint32_t plain_value) {
	uint32_t mask = 0x1;
	return (oldword & (~(mask << 0))) | (mask & plain_value)<< 0 ;
}
static inline void user_gpio_ev_pending_i0_write(uint32_t plain_value) {
	uint32_t oldword = user_gpio_ev_pending_read();
	uint32_t newword = user_gpio_ev_pending_i0_replace(oldword, plain_value);
	user_gpio_ev_pending_write(newword);
}
#define CSR_USER_GPIO_EV_PENDING_I1_OFFSET 1
#define CSR_USER_GPIO_EV_PENDING_I1_SIZE 1
static inline uint32_t user_gpio_ev_pending_i1_extract(uint32_t oldword) {
	uint32_t mask = 0x1;
	return ( (oldword >> 1) & mask );
}
static inline uint32_t user_gpio_ev_pending_i1_read(void) {
	uint32_t word = user_gpio_ev_pending_read();
	return user_gpio_ev_pending_i1_extract(word);
}
static inline uint32_t user_gpio_ev_pending_i1_replace(uint32_t oldword, uint32_t plain_value) {
	uint32_t mask = 0x1;
	return (oldword & (~(mask << 1))) | (mask & plain_value)<< 1 ;
}
static inline void user_gpio_ev_pending_i1_write(uint32_t plain_value) {
	uint32_t oldword = user_gpio_ev_pending_read();
	uint32_t newword = user_gpio_ev_pending_i1_replace(oldword, plain_value);
	user_gpio_ev_pending_write(newword);
}
#define CSR_USER_GPIO_EV_PENDING_I2_OFFSET 2
#define CSR_USER_GPIO_EV_PENDING_I2_SIZE 1
static inline uint32_t user_gpio_ev_pending_i2_extract(uint32_t oldword) {
	uint32_t mask = 0x1;
	return ( (oldword >> 2) & mask );
}
static inline uint32_t user_gpio_ev_pending_i2_read(void) {
	uint32_t word = user_gpio_ev_pending_read();
	return user_gpio_ev_pending_i2_extract(word);
}
static inline uint32_t user_gpio_ev_pending_i2_replace(uint32_t oldword, uint32_t plain_value) {
	uint32_t mask = 0x1;
	return (oldword & (~(mask << 2))) | (mask & plain_value)<< 2 ;
}
static inline void user_gpio_ev_pending_i2_write(uint32_t plain_value) {
	uint32_t oldword = user_gpio_ev_pending_read();
	uint32_t newword = user_gpio_ev_pending_i2_replace(oldword, plain_value);
	user_gpio_ev_pending_write(newword);
}
#define CSR_USER_GPIO_EV_PENDING_I3_OFFSET 3
#define CSR_USER_GPIO_EV_PENDING_I3_SIZE 1
static inline uint32_t user_gpio_ev_pending_i3_extract(uint32_t oldword) {
	uint32_t mask = 0x1;
	return ( (oldword >> 3) & mask );
}
static inline uint32_t user_gpio_ev_pending_i3_read(void) {
	uint32_t word = user_gpio_ev_pending_read();
	return user_gpio_ev_pending_i3_extract(word);
}
static inline uint32_t user_gpio_ev_pending_i3_replace(uint32_t oldword, uint32_t plain_value) {
	uint32_t mask = 0x1;
	return (oldword & (~(mask << 3))) | (mask & plain_value)<< 3 ;
}
static inline void user_gpio_ev_pending_i3_write(uint32_t plain_value) {
	uint32_t oldword = user_gpio_ev_pending_read();
	uint32_t newword = user_gpio_ev_pending_i3_replace(oldword, plain_value);
	user_gpio_ev_pending_write(newword);
}
#define CSR_USER_GPIO_EV_ENABLE_ADDR (CSR_BASE + 0x581cL)
#define CSR_USER_GPIO_EV_ENABLE_SIZE 1
static inline uint32_t user_gpio_ev_enable_read(void) {
	return csr_read_simple((CSR_BASE + 0x581cL));
}
static inline void user_gpio_ev_enable_write(uint32_t v) {
	csr_write_simple(v, (CSR_BASE + 0x581cL));
}
#define CSR_USER_GPIO_EV_ENABLE_I0_OFFSET 0
#define CSR_USER_GPIO_EV_ENABLE_I0_SIZE 1
static inline uint32_t user_gpio_ev_enable_i0_extract(uint32_t oldword) {
	uint32_t mask = 0x1;
	return ( (oldword >> 0) & mask );
}
static inline uint32_t user_gpio_ev_enable_i0_read(void) {
	uint32_t word = user_gpio_ev_enable_read();
	return user_gpio_ev_enable_i0_extract(word);
}
static inline uint32_t user_gpio_ev_enable_i0_replace(uint32_t oldword, uint32_t plain_value) {
	uint32_t mask = 0x1;
	return (oldword & (~(mask << 0))) | (mask & plain_value)<< 0 ;
}
static inline void user_gpio_ev_enable_i0_write(uint32_t plain_value) {
	uint32_t oldword = user_gpio_ev_enable_read();
	uint32_t newword = user_gpio_ev_enable_i0_replace(oldword, plain_value);
	user_gpio_ev_enable_write(newword);
}
#define CSR_USER_GPIO_EV_ENABLE_I1_OFFSET 1
#define CSR_USER_GPIO_EV_ENABLE_I1_SIZE 1
static inline uint32_t user_gpio_ev_enable_i1_extract(uint32_t oldword) {
	uint32_t mask = 0x1;
	return ( (oldword >> 1) & mask );
}
static inline uint32_t user_gpio_ev_enable_i1_read(void) {
	uint32_t word = user_gpio_ev_enable_read();
	return user_gpio_ev_enable_i1_extract(word);
}
static inline uint32_t user_gpio_ev_enable_i1_replace(uint32_t oldword, uint32_t plain_value) {
	uint32_t mask = 0x1;
	return (oldword & (~(mask << 1))) | (mask & plain_value)<< 1 ;
}
static inline void user_gpio_ev_enable_i1_write(uint32_t plain_value) {
	uint32_t oldword = user_gpio_ev_enable_read();
	uint32_t newword = user_gpio_ev_enable_i1_replace(oldword, plain_value);
	user_gpio_ev_enable_write(newword);
}
#define CSR_USER_GPIO_EV_ENABLE_I2_OFFSET 2
#define CSR_USER_GPIO_EV_ENABLE_I2_SIZE 1
static inline uint32_t user_gpio_ev_enable_i2_extract(uint32_t oldword) {
	uint32_t mask = 0x1;
	return ( (oldword >> 2) & mask );
}
static inline uint32_t user_gpio_ev_enable_i2_read(void) {
	uint32_t word = user_gpio_ev_enable_read();
	return user_gpio_ev_enable_i2_extract(word);
}
static inline uint32_t user_gpio_ev_enable_i2_replace(uint32_t oldword, uint32_t plain_value) {
	uint32_t mask = 0x1;
	return (oldword & (~(mask << 2))) | (mask & plain_value)<< 2 ;
}
static inline void user_gpio_ev_enable_i2_write(uint32_t plain_value) {
	uint32_t oldword = user_gpio_ev_enable_read();
	uint32_t newword = user_gpio_ev_enable_i2_replace(oldword, plain_value);
	user_gpio_ev_enable_write(newword);
}
#define CSR_USER_GPIO_EV_ENABLE_I3_OFFSET 3
#define CSR_USER_GPIO_EV_ENABLE_I3_SIZE 1
static inline uint32_t user_gpio_ev_enable_i3_extract(uint32_t oldword) {
	uint32_t mask = 0x1;
	return ( (oldword >> 3) & mask );
}
static inline uint32_t user_gpio_ev_enable_i3_read(void) {
	uint32_t word = user_gpio_ev_enable_read();
	return user_gpio_ev_enable_i3_extract(word);
}
static inline uint32_t user_gpio_ev_enable_i3_replace(uint32_t oldword, uint32_t plain_value) {
	uint32_t mask = 0x1;
	return (oldword & (~(mask << 3))) | (mask & plain_value)<< 3 ;
}
static inline void user_gpio_ev_enable_i3_write(uint32_t plain_value) {
	uint32_t oldword = user_gpio_ev_enable_read();
	uint32_t newword = user_gpio_ev_enable_i3_replace(oldword, plain_value);
	user_gpio_ev_enable_write(newword);
}
```
