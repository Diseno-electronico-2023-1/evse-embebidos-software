## CMakeLists.txt
```
# SPDX-License-Identifier: Apache-2.0

cmake_minimum_required(VERSION 3.20.0)

find_package(Zephyr REQUIRED HINTS $ENV{ZEPHYR_BASE})
project(cargador)

FILE(GLOB app_sources src/bluetooth.c)

target_sources(app PRIVATE ${app_sources})

set(gen_dir ${ZEPHYR_BINARY_DIR}/include/generated/)

generate_inc_file_for_target(app src/server/response_big.html.bin   ${gen_dir}/response_big.html.bin.inc)

include(${ZEPHYR_BASE}/samples/net/common/common.cmake)
```

## prj.conf
```kconfig
# General config
CONFIG_NEWLIB_LIBC=y

# Networking config
CONFIG_NETWORKING=y
CONFIG_NET_IPV4=y
CONFIG_NET_IPV6=n
CONFIG_NET_TCP=y
CONFIG_NET_SOCKETS=y
CONFIG_NET_SOCKETS_POSIX_NAMES=y

# Network driver config
CONFIG_TEST_RANDOM_GENERATOR=y

# Network address config
CONFIG_NET_CONFIG_SETTINGS=y
CONFIG_NET_CONFIG_NEED_IPV4=y
CONFIG_NET_CONFIG_MY_IPV4_ADDR="192.0.2.1"
CONFIG_NET_CONFIG_PEER_IPV4_ADDR="192.0.2.2"

# Networking tweaks
# Required to handle large number of consecutive connections,
# e.g. when testing with ApacheBench.
CONFIG_NET_TCP_TIME_WAIT_DELAY=0

# Network debug config
CONFIG_NET_LOG=y
#CONFIG_NET_SHELL=y

CONFIG_LV_Z_MEM_POOL_NUMBER_BLOCKS=8
CONFIG_MAIN_STACK_SIZE=2048

CONFIG_DISPLAY=y
CONFIG_DISPLAY_LOG_LEVEL_ERR=y

CONFIG_PRINTK=y
CONFIG_LOG=y

CONFIG_LVGL=y
CONFIG_LV_MEM_CUSTOM=y
CONFIG_LV_USE_LOG=y
CONFIG_LV_USE_LABEL=y
CONFIG_LV_USE_BTN=y
CONFIG_LV_USE_IMG=y
CONFIG_LV_FONT_MONTSERRAT_14=y


CONFIG_UART_0_NAME="UART_2"
CONFIG_UART_0_BAUD_RATE=9600
CONFIG_UART_0_IRQ_PRI=3
CONFIG_UART_INTERRUPT_DRIVEN=y
CONFIG_SERIAL=y
```

## src/main.c
```c
#include <stdio.h>
#include <string.h>

#include <lvgl.h>
// #include <zephyr/device.h>
// #include <zephyr/devicetree.h>
// #include <zephyr/drivers/display.h>
// #include <zephyr/drivers/gpio.h>
// #include <zephyr/kernel.h>
// #include <zephyr/sys/printk.h>

// #define LOG_LEVEL CONFIG_LOG_DEFAULT_LEVEL
// #include <zephyr/logging/log.h>
// LOG_MODULE_REGISTER(app);

#include "csr.h"
#include "screens/offScreen.c"
#include "screens/welcomeScreen.c"
#include "screens/profileScreen.c"
#include "screens/statusScreen.c"

#include "server/server.c"

// Botones
    const int btn_back = 1;
    const int btn_up   = 2;
    const int btn_down = 4;
    const int btn_next = 8;

int moveSelector(int selector, int btn_state, int maxSelector){
    if (btn_state == btn_down){
        if (selector == maxSelector){
            selector = 1;
        } else{
            selector ++;
        }
    } else if (btn_state == btn_up){
        if (selector == 1){
            selector = maxSelector;
        } else{
            selector --;
        }
    }
    return selector;
}


/* void main(void){
    char names[3][16];
    strncpy(names[0], "Hugo", sizeof(names[0]) - 1);
    strncpy(names[1], "Paco", sizeof(names[1]) - 1);
    strncpy(names[2], "Luis", sizeof(names[2]) - 1);

    int percent = 0;


    printk("Inicio \n");

    bool work = 1;
    int state;
    int btn_state;
    int selector = 1;
    int profile_sel = 1;

    // Estados
    const int welcome = '1';
    const int selprofile = '2';
    const int status = '3';
    const int end = '4';
        
    state = welcome;
    welcome_screen();
    lv_task_handler();

    while (work){
        switch (state){
        case welcome :
            btn_state = user_gpio_in_read();

            if (btn_state != 0){   
                profile_screen(1, names);
                lv_task_handler();
                selector = 1;
                state = selprofile;
            }
            break;
        
        case selprofile :
            btn_state = user_gpio_in_read();
            
            if (btn_state != 0){   
                if (btn_state == btn_back){
                    state = welcome;
                    welcome_screen();
                    lv_task_handler();
                } else if (btn_state == btn_next){
                    state = status;
                    profile_sel = selector - 1;
                    selector = 1;
                    status_screen(selector, names[profile_sel], percent);
                    lv_task_handler();
                } else{
                    selector = moveSelector(selector, btn_state, 3);
                    profile_screen(selector, names);
                    lv_task_handler();
                }
            }
            break;

        case status :
            btn_state = user_gpio_in_read();
            
            if (btn_state != 0){   
                if (btn_state == btn_back){
                    state = selprofile;
                    selector = 1;
                    profile_screen(selector, names);
                    lv_task_handler();                    
                } else if (btn_state == btn_next){
                    off_screen();
                    lv_task_handler();
                    selector = 1;
                    state = end;
                } else{
                    selector = moveSelector(selector, btn_state, 5);
                    status_screen(selector, names[profile_sel], percent);
                    lv_task_handler();
                }
            }
            break;

        default:
            work = 0;
            break;
        }

        k_sleep(K_MSEC(100));
    }
    
    printk("Fin \n");

} */


void main(void){
    
    welcome_screen();
    lv_task_handler();
    server();
        
}

//k_sleep(K_MSEC(1000));
//perfil();
//lv_task_handler();
//printk("Data: %x \n", data);
//user_gpio_out_write(1);
```

## src/csr.h
```c
//--------------------------------------------------------------------------------
// Auto-generated by LiteX (782f045b) on 2023-06-22 08:23:23
//--------------------------------------------------------------------------------
#define CSR_BASE 0xf0000000L

#define MMPTR(a) (*((volatile uint32_t *)(a)))

static inline void csr_write_simple(unsigned long v, unsigned long a)
{
	MMPTR(a) = v;
}

static inline unsigned long csr_read_simple(unsigned long a)
{
	return MMPTR(a);
}

/* spi */
#define CSR_SPI_BASE (CSR_BASE + 0x0L)
#define CSR_SPI_CONTROL_ADDR (CSR_BASE + 0x0L)
#define CSR_SPI_CONTROL_SIZE 1
static inline uint32_t spi_control_read(void) {
	return csr_read_simple((CSR_BASE + 0x0L));
}
static inline void spi_control_write(uint32_t v) {
	csr_write_simple(v, (CSR_BASE + 0x0L));
}
#define CSR_SPI_CONTROL_START_OFFSET 0
#define CSR_SPI_CONTROL_START_SIZE 1
static inline uint32_t spi_control_start_extract(uint32_t oldword) {
	uint32_t mask = 0x1;
	return ( (oldword >> 0) & mask );
}
static inline uint32_t spi_control_start_read(void) {
	uint32_t word = spi_control_read();
	return spi_control_start_extract(word);
}
static inline uint32_t spi_control_start_replace(uint32_t oldword, uint32_t plain_value) {
	uint32_t mask = 0x1;
	return (oldword & (~(mask << 0))) | (mask & plain_value)<< 0 ;
}
static inline void spi_control_start_write(uint32_t plain_value) {
	uint32_t oldword = spi_control_read();
	uint32_t newword = spi_control_start_replace(oldword, plain_value);
	spi_control_write(newword);
}
#define CSR_SPI_CONTROL_LENGTH_OFFSET 8
#define CSR_SPI_CONTROL_LENGTH_SIZE 8
static inline uint32_t spi_control_length_extract(uint32_t oldword) {
	uint32_t mask = 0xff;
	return ( (oldword >> 8) & mask );
}
static inline uint32_t spi_control_length_read(void) {
	uint32_t word = spi_control_read();
	return spi_control_length_extract(word);
}
static inline uint32_t spi_control_length_replace(uint32_t oldword, uint32_t plain_value) {
	uint32_t mask = 0xff;
	return (oldword & (~(mask << 8))) | (mask & plain_value)<< 8 ;
}
static inline void spi_control_length_write(uint32_t plain_value) {
	uint32_t oldword = spi_control_read();
	uint32_t newword = spi_control_length_replace(oldword, plain_value);
	spi_control_write(newword);
}
#define CSR_SPI_STATUS_ADDR (CSR_BASE + 0x4L)
#define CSR_SPI_STATUS_SIZE 1
static inline uint32_t spi_status_read(void) {
	return csr_read_simple((CSR_BASE + 0x4L));
}
#define CSR_SPI_STATUS_DONE_OFFSET 0
#define CSR_SPI_STATUS_DONE_SIZE 1
static inline uint32_t spi_status_done_extract(uint32_t oldword) {
	uint32_t mask = 0x1;
	return ( (oldword >> 0) & mask );
}
static inline uint32_t spi_status_done_read(void) {
	uint32_t word = spi_status_read();
	return spi_status_done_extract(word);
}
#define CSR_SPI_STATUS_MODE_OFFSET 1
#define CSR_SPI_STATUS_MODE_SIZE 1
static inline uint32_t spi_status_mode_extract(uint32_t oldword) {
	uint32_t mask = 0x1;
	return ( (oldword >> 1) & mask );
}
static inline uint32_t spi_status_mode_read(void) {
	uint32_t word = spi_status_read();
	return spi_status_mode_extract(word);
}
#define CSR_SPI_MOSI_ADDR (CSR_BASE + 0x8L)
#define CSR_SPI_MOSI_SIZE 1
static inline uint32_t spi_mosi_read(void) {
	return csr_read_simple((CSR_BASE + 0x8L));
}
static inline void spi_mosi_write(uint32_t v) {
	csr_write_simple(v, (CSR_BASE + 0x8L));
}
#define CSR_SPI_MISO_ADDR (CSR_BASE + 0xcL)
#define CSR_SPI_MISO_SIZE 1
static inline uint32_t spi_miso_read(void) {
	return csr_read_simple((CSR_BASE + 0xcL));
}
#define CSR_SPI_CS_ADDR (CSR_BASE + 0x10L)
#define CSR_SPI_CS_SIZE 1
static inline uint32_t spi_cs_read(void) {
	return csr_read_simple((CSR_BASE + 0x10L));
}
static inline void spi_cs_write(uint32_t v) {
	csr_write_simple(v, (CSR_BASE + 0x10L));
}
#define CSR_SPI_CS_SEL_OFFSET 0
#define CSR_SPI_CS_SEL_SIZE 1
static inline uint32_t spi_cs_sel_extract(uint32_t oldword) {
	uint32_t mask = 0x1;
	return ( (oldword >> 0) & mask );
}
static inline uint32_t spi_cs_sel_read(void) {
	uint32_t word = spi_cs_read();
	return spi_cs_sel_extract(word);
}
static inline uint32_t spi_cs_sel_replace(uint32_t oldword, uint32_t plain_value) {
	uint32_t mask = 0x1;
	return (oldword & (~(mask << 0))) | (mask & plain_value)<< 0 ;
}
static inline void spi_cs_sel_write(uint32_t plain_value) {
	uint32_t oldword = spi_cs_read();
	uint32_t newword = spi_cs_sel_replace(oldword, plain_value);
	spi_cs_write(newword);
}
#define CSR_SPI_CS_MODE_OFFSET 16
#define CSR_SPI_CS_MODE_SIZE 1
static inline uint32_t spi_cs_mode_extract(uint32_t oldword) {
	uint32_t mask = 0x1;
	return ( (oldword >> 16) & mask );
}
static inline uint32_t spi_cs_mode_read(void) {
	uint32_t word = spi_cs_read();
	return spi_cs_mode_extract(word);
}
static inline uint32_t spi_cs_mode_replace(uint32_t oldword, uint32_t plain_value) {
	uint32_t mask = 0x1;
	return (oldword & (~(mask << 16))) | (mask & plain_value)<< 16 ;
}
static inline void spi_cs_mode_write(uint32_t plain_value) {
	uint32_t oldword = spi_cs_read();
	uint32_t newword = spi_cs_mode_replace(oldword, plain_value);
	spi_cs_write(newword);
}
#define CSR_SPI_LOOPBACK_ADDR (CSR_BASE + 0x14L)
#define CSR_SPI_LOOPBACK_SIZE 1
static inline uint32_t spi_loopback_read(void) {
	return csr_read_simple((CSR_BASE + 0x14L));
}
static inline void spi_loopback_write(uint32_t v) {
	csr_write_simple(v, (CSR_BASE + 0x14L));
}
#define CSR_SPI_LOOPBACK_MODE_OFFSET 0
#define CSR_SPI_LOOPBACK_MODE_SIZE 1
static inline uint32_t spi_loopback_mode_extract(uint32_t oldword) {
	uint32_t mask = 0x1;
	return ( (oldword >> 0) & mask );
}
static inline uint32_t spi_loopback_mode_read(void) {
	uint32_t word = spi_loopback_read();
	return spi_loopback_mode_extract(word);
}
static inline uint32_t spi_loopback_mode_replace(uint32_t oldword, uint32_t plain_value) {
	uint32_t mask = 0x1;
	return (oldword & (~(mask << 0))) | (mask & plain_value)<< 0 ;
}
static inline void spi_loopback_mode_write(uint32_t plain_value) {
	uint32_t oldword = spi_loopback_read();
	uint32_t newword = spi_loopback_mode_replace(oldword, plain_value);
	spi_loopback_write(newword);
}
#define CSR_SPI_CLK_DIVIDER_ADDR (CSR_BASE + 0x18L)
#define CSR_SPI_CLK_DIVIDER_SIZE 1
static inline uint32_t spi_clk_divider_read(void) {
	return csr_read_simple((CSR_BASE + 0x18L));
}
static inline void spi_clk_divider_write(uint32_t v) {
	csr_write_simple(v, (CSR_BASE + 0x18L));
}

/* user_gpio */
#define CSR_USER_GPIO_BASE (CSR_BASE + 0x6000L)
#define CSR_USER_GPIO_OE_ADDR (CSR_BASE + 0x6000L)
#define CSR_USER_GPIO_OE_SIZE 1
static inline uint32_t user_gpio_oe_read(void) {
	return csr_read_simple((CSR_BASE + 0x6000L));
}
static inline void user_gpio_oe_write(uint32_t v) {
	csr_write_simple(v, (CSR_BASE + 0x6000L));
}
#define CSR_USER_GPIO_IN_ADDR (CSR_BASE + 0x6004L)
#define CSR_USER_GPIO_IN_SIZE 1
static inline uint32_t user_gpio_in_read(void) {
	return csr_read_simple((CSR_BASE + 0x6004L));
}
#define CSR_USER_GPIO_OUT_ADDR (CSR_BASE + 0x6008L)
#define CSR_USER_GPIO_OUT_SIZE 1
static inline uint32_t user_gpio_out_read(void) {
	return csr_read_simple((CSR_BASE + 0x6008L));
}
static inline void user_gpio_out_write(uint32_t v) {
	csr_write_simple(v, (CSR_BASE + 0x6008L));
}
#define CSR_USER_GPIO_MODE_ADDR (CSR_BASE + 0x600cL)
#define CSR_USER_GPIO_MODE_SIZE 1
static inline uint32_t user_gpio_mode_read(void) {
	return csr_read_simple((CSR_BASE + 0x600cL));
}
static inline void user_gpio_mode_write(uint32_t v) {
	csr_write_simple(v, (CSR_BASE + 0x600cL));
}
#define CSR_USER_GPIO_EDGE_ADDR (CSR_BASE + 0x6010L)
#define CSR_USER_GPIO_EDGE_SIZE 1
static inline uint32_t user_gpio_edge_read(void) {
	return csr_read_simple((CSR_BASE + 0x6010L));
}
static inline void user_gpio_edge_write(uint32_t v) {
	csr_write_simple(v, (CSR_BASE + 0x6010L));
}
#define CSR_USER_GPIO_EV_STATUS_ADDR (CSR_BASE + 0x6014L)
#define CSR_USER_GPIO_EV_STATUS_SIZE 1
static inline uint32_t user_gpio_ev_status_read(void) {
	return csr_read_simple((CSR_BASE + 0x6014L));
}
#define CSR_USER_GPIO_EV_STATUS_I0_OFFSET 0
#define CSR_USER_GPIO_EV_STATUS_I0_SIZE 1
static inline uint32_t user_gpio_ev_status_i0_extract(uint32_t oldword) {
	uint32_t mask = 0x1;
	return ( (oldword >> 0) & mask );
}
static inline uint32_t user_gpio_ev_status_i0_read(void) {
	uint32_t word = user_gpio_ev_status_read();
	return user_gpio_ev_status_i0_extract(word);
}
#define CSR_USER_GPIO_EV_STATUS_I1_OFFSET 1
#define CSR_USER_GPIO_EV_STATUS_I1_SIZE 1
static inline uint32_t user_gpio_ev_status_i1_extract(uint32_t oldword) {
	uint32_t mask = 0x1;
	return ( (oldword >> 1) & mask );
}
static inline uint32_t user_gpio_ev_status_i1_read(void) {
	uint32_t word = user_gpio_ev_status_read();
	return user_gpio_ev_status_i1_extract(word);
}
#define CSR_USER_GPIO_EV_STATUS_I2_OFFSET 2
#define CSR_USER_GPIO_EV_STATUS_I2_SIZE 1
static inline uint32_t user_gpio_ev_status_i2_extract(uint32_t oldword) {
	uint32_t mask = 0x1;
	return ( (oldword >> 2) & mask );
}
static inline uint32_t user_gpio_ev_status_i2_read(void) {
	uint32_t word = user_gpio_ev_status_read();
	return user_gpio_ev_status_i2_extract(word);
}
#define CSR_USER_GPIO_EV_STATUS_I3_OFFSET 3
#define CSR_USER_GPIO_EV_STATUS_I3_SIZE 1
static inline uint32_t user_gpio_ev_status_i3_extract(uint32_t oldword) {
	uint32_t mask = 0x1;
	return ( (oldword >> 3) & mask );
}
static inline uint32_t user_gpio_ev_status_i3_read(void) {
	uint32_t word = user_gpio_ev_status_read();
	return user_gpio_ev_status_i3_extract(word);
}
#define CSR_USER_GPIO_EV_PENDING_ADDR (CSR_BASE + 0x6018L)
#define CSR_USER_GPIO_EV_PENDING_SIZE 1
static inline uint32_t user_gpio_ev_pending_read(void) {
	return csr_read_simple((CSR_BASE + 0x6018L));
}
static inline void user_gpio_ev_pending_write(uint32_t v) {
	csr_write_simple(v, (CSR_BASE + 0x6018L));
}
#define CSR_USER_GPIO_EV_PENDING_I0_OFFSET 0
#define CSR_USER_GPIO_EV_PENDING_I0_SIZE 1
static inline uint32_t user_gpio_ev_pending_i0_extract(uint32_t oldword) {
	uint32_t mask = 0x1;
	return ( (oldword >> 0) & mask );
}
static inline uint32_t user_gpio_ev_pending_i0_read(void) {
	uint32_t word = user_gpio_ev_pending_read();
	return user_gpio_ev_pending_i0_extract(word);
}
static inline uint32_t user_gpio_ev_pending_i0_replace(uint32_t oldword, uint32_t plain_value) {
	uint32_t mask = 0x1;
	return (oldword & (~(mask << 0))) | (mask & plain_value)<< 0 ;
}
static inline void user_gpio_ev_pending_i0_write(uint32_t plain_value) {
	uint32_t oldword = user_gpio_ev_pending_read();
	uint32_t newword = user_gpio_ev_pending_i0_replace(oldword, plain_value);
	user_gpio_ev_pending_write(newword);
}
#define CSR_USER_GPIO_EV_PENDING_I1_OFFSET 1
#define CSR_USER_GPIO_EV_PENDING_I1_SIZE 1
static inline uint32_t user_gpio_ev_pending_i1_extract(uint32_t oldword) {
	uint32_t mask = 0x1;
	return ( (oldword >> 1) & mask );
}
static inline uint32_t user_gpio_ev_pending_i1_read(void) {
	uint32_t word = user_gpio_ev_pending_read();
	return user_gpio_ev_pending_i1_extract(word);
}
static inline uint32_t user_gpio_ev_pending_i1_replace(uint32_t oldword, uint32_t plain_value) {
	uint32_t mask = 0x1;
	return (oldword & (~(mask << 1))) | (mask & plain_value)<< 1 ;
}
static inline void user_gpio_ev_pending_i1_write(uint32_t plain_value) {
	uint32_t oldword = user_gpio_ev_pending_read();
	uint32_t newword = user_gpio_ev_pending_i1_replace(oldword, plain_value);
	user_gpio_ev_pending_write(newword);
}
#define CSR_USER_GPIO_EV_PENDING_I2_OFFSET 2
#define CSR_USER_GPIO_EV_PENDING_I2_SIZE 1
static inline uint32_t user_gpio_ev_pending_i2_extract(uint32_t oldword) {
	uint32_t mask = 0x1;
	return ( (oldword >> 2) & mask );
}
static inline uint32_t user_gpio_ev_pending_i2_read(void) {
	uint32_t word = user_gpio_ev_pending_read();
	return user_gpio_ev_pending_i2_extract(word);
}
static inline uint32_t user_gpio_ev_pending_i2_replace(uint32_t oldword, uint32_t plain_value) {
	uint32_t mask = 0x1;
	return (oldword & (~(mask << 2))) | (mask & plain_value)<< 2 ;
}
static inline void user_gpio_ev_pending_i2_write(uint32_t plain_value) {
	uint32_t oldword = user_gpio_ev_pending_read();
	uint32_t newword = user_gpio_ev_pending_i2_replace(oldword, plain_value);
	user_gpio_ev_pending_write(newword);
}
#define CSR_USER_GPIO_EV_PENDING_I3_OFFSET 3
#define CSR_USER_GPIO_EV_PENDING_I3_SIZE 1
static inline uint32_t user_gpio_ev_pending_i3_extract(uint32_t oldword) {
	uint32_t mask = 0x1;
	return ( (oldword >> 3) & mask );
}
static inline uint32_t user_gpio_ev_pending_i3_read(void) {
	uint32_t word = user_gpio_ev_pending_read();
	return user_gpio_ev_pending_i3_extract(word);
}
static inline uint32_t user_gpio_ev_pending_i3_replace(uint32_t oldword, uint32_t plain_value) {
	uint32_t mask = 0x1;
	return (oldword & (~(mask << 3))) | (mask & plain_value)<< 3 ;
}
static inline void user_gpio_ev_pending_i3_write(uint32_t plain_value) {
	uint32_t oldword = user_gpio_ev_pending_read();
	uint32_t newword = user_gpio_ev_pending_i3_replace(oldword, plain_value);
	user_gpio_ev_pending_write(newword);
}
#define CSR_USER_GPIO_EV_ENABLE_ADDR (CSR_BASE + 0x601cL)
#define CSR_USER_GPIO_EV_ENABLE_SIZE 1
static inline uint32_t user_gpio_ev_enable_read(void) {
	return csr_read_simple((CSR_BASE + 0x601cL));
}
static inline void user_gpio_ev_enable_write(uint32_t v) {
	csr_write_simple(v, (CSR_BASE + 0x601cL));
}
#define CSR_USER_GPIO_EV_ENABLE_I0_OFFSET 0
#define CSR_USER_GPIO_EV_ENABLE_I0_SIZE 1
static inline uint32_t user_gpio_ev_enable_i0_extract(uint32_t oldword) {
	uint32_t mask = 0x1;
	return ( (oldword >> 0) & mask );
}
static inline uint32_t user_gpio_ev_enable_i0_read(void) {
	uint32_t word = user_gpio_ev_enable_read();
	return user_gpio_ev_enable_i0_extract(word);
}
static inline uint32_t user_gpio_ev_enable_i0_replace(uint32_t oldword, uint32_t plain_value) {
	uint32_t mask = 0x1;
	return (oldword & (~(mask << 0))) | (mask & plain_value)<< 0 ;
}
static inline void user_gpio_ev_enable_i0_write(uint32_t plain_value) {
	uint32_t oldword = user_gpio_ev_enable_read();
	uint32_t newword = user_gpio_ev_enable_i0_replace(oldword, plain_value);
	user_gpio_ev_enable_write(newword);
}
#define CSR_USER_GPIO_EV_ENABLE_I1_OFFSET 1
#define CSR_USER_GPIO_EV_ENABLE_I1_SIZE 1
static inline uint32_t user_gpio_ev_enable_i1_extract(uint32_t oldword) {
	uint32_t mask = 0x1;
	return ( (oldword >> 1) & mask );
}
static inline uint32_t user_gpio_ev_enable_i1_read(void) {
	uint32_t word = user_gpio_ev_enable_read();
	return user_gpio_ev_enable_i1_extract(word);
}
static inline uint32_t user_gpio_ev_enable_i1_replace(uint32_t oldword, uint32_t plain_value) {
	uint32_t mask = 0x1;
	return (oldword & (~(mask << 1))) | (mask & plain_value)<< 1 ;
}
static inline void user_gpio_ev_enable_i1_write(uint32_t plain_value) {
	uint32_t oldword = user_gpio_ev_enable_read();
	uint32_t newword = user_gpio_ev_enable_i1_replace(oldword, plain_value);
	user_gpio_ev_enable_write(newword);
}
#define CSR_USER_GPIO_EV_ENABLE_I2_OFFSET 2
#define CSR_USER_GPIO_EV_ENABLE_I2_SIZE 1
static inline uint32_t user_gpio_ev_enable_i2_extract(uint32_t oldword) {
	uint32_t mask = 0x1;
	return ( (oldword >> 2) & mask );
}
static inline uint32_t user_gpio_ev_enable_i2_read(void) {
	uint32_t word = user_gpio_ev_enable_read();
	return user_gpio_ev_enable_i2_extract(word);
}
static inline uint32_t user_gpio_ev_enable_i2_replace(uint32_t oldword, uint32_t plain_value) {
	uint32_t mask = 0x1;
	return (oldword & (~(mask << 2))) | (mask & plain_value)<< 2 ;
}
static inline void user_gpio_ev_enable_i2_write(uint32_t plain_value) {
	uint32_t oldword = user_gpio_ev_enable_read();
	uint32_t newword = user_gpio_ev_enable_i2_replace(oldword, plain_value);
	user_gpio_ev_enable_write(newword);
}
#define CSR_USER_GPIO_EV_ENABLE_I3_OFFSET 3
#define CSR_USER_GPIO_EV_ENABLE_I3_SIZE 1
static inline uint32_t user_gpio_ev_enable_i3_extract(uint32_t oldword) {
	uint32_t mask = 0x1;
	return ( (oldword >> 3) & mask );
}
static inline uint32_t user_gpio_ev_enable_i3_read(void) {
	uint32_t word = user_gpio_ev_enable_read();
	return user_gpio_ev_enable_i3_extract(word);
}
static inline uint32_t user_gpio_ev_enable_i3_replace(uint32_t oldword, uint32_t plain_value) {
	uint32_t mask = 0x1;
	return (oldword & (~(mask << 3))) | (mask & plain_value)<< 3 ;
}
static inline void user_gpio_ev_enable_i3_write(uint32_t plain_value) {
	uint32_t oldword = user_gpio_ev_enable_read();
	uint32_t newword = user_gpio_ev_enable_i3_replace(oldword, plain_value);
	user_gpio_ev_enable_write(newword);
}
```
